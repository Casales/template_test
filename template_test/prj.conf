## CMakeLists.txt
```
# SPDX-License-Identifier: Apache-2.0

cmake_minimum_required(VERSION 3.20.0)

set(BKLIBC_URL https://gitlab.bigkaiser.tel/r-d-group/libraries/bklibc.git)
set(BKLIBC_TAG main)
set(BKLIBC_PATH ${CMAKE_SOURCE_DIR}/../../bklibc/${BKLIBC_TAG})

# Run the batch script with arguments
execute_process(
    COMMAND clone_repository.bat ${BKLIBC_URL} ${BKLIBC_PATH} ${BKLIBC_TAG}
    WORKING_DIRECTORY ${CMAKE_SOURCE_DIR}/../scripts
    RESULT_VARIABLE result
    OUTPUT_VARIABLE script_output
)

if(result EQUAL 0)
    message(STATUS "Script executed successfully")
    message(STATUS "${script_output}")
elseif(result EQUAL 1)
    message(WARNING "Script executed with warning:")
    message(WARNING "${script_output}")
else()
    message(FATAL_ERROR "Failed to run clone_repository.bat. Return code: ${result}")
    message(FATAL_ERROR "${script_output}")
endif()

#prepend current directory to board root list to allow adding new boards and overwriting boards that exist in the zephyr tree
list(PREPEND BOARD_ROOT ${CMAKE_CURRENT_SOURCE_DIR})
#append board root to include boards from bklibc
list(APPEND BOARD_ROOT ${BKLIBC_PATH}/include/zephyr)

add_compile_definitions(SERIAL_LOG_LEVEL=3)

find_package(Zephyr REQUIRED HINTS $ENV{ZEPHYR_BASE})
project(template_test)

target_include_directories(app
    PRIVATE
        ${BKLIBC_PATH}/include
        ${BKLIBC_PATH}/include/zephyr

)
target_sources(app
    PRIVATE
    src/main.c
    ${BKLIBC_PATH}/src/rion_application_interface.c
    ${BKLIBC_PATH}/src/rion_encoding.c
    ${BKLIBC_PATH}/src/zephyr/ble_serial.c
    ${BKLIBC_PATH}/src/zephyr/serial.c
    ${BKLIBC_PATH}/src/zephyr/serial_internal.c
    ${BKLIBC_PATH}/src/zephyr/uart_serial.c
    ${BKLIBC_PATH}/src/rion_object_buffer.c
    src/api.c)
```

## prj.conf
```kconfig
#logging
CONFIG_LOG=y
CONFIG_LOG_DEFAULT_LEVEL=3
CONFIG_LOG_BACKEND_RTT=y
CONFIG_LOG_BACKEND_UART=n

#serial
CONFIG_SERIAL=y
CONFIG_UART_INTERRUPT_DRIVEN=y
CONFIG_UART_LINE_CTRL=y

#bluetooth
CONFIG_BT=y
CONFIG_BT_PERIPHERAL=y
CONFIG_BT_NUS=y
CONFIG_BT_DEVICE_NAME="template_test"
CONFIG_BT_MAX_CONN=1
CONFIG_BT_LL_SOFTDEVICE=y

#increase bt throughput
CONFIG_BT_GATT_CLIENT=y
CONFIG_BT_BUF_ACL_RX_SIZE=251
CONFIG_BT_BUF_ACL_TX_SIZE=251
CONFIG_BT_L2CAP_TX_MTU=257
CONFIG_BT_CTLR_DATA_LENGTH_MAX=251
CONFIG_BT_CTLR_ADV_DATA_LEN_MAX=256
CONFIG_MAIN_STACK_SIZE=2048
CONFIG_SYSTEM_WORKQUEUE_STACK_SIZE=4096
```

## src/main.c
```c
/*
 * Copyright (c) 2012-2014 Wind River Systems, Inc.
 *
 * SPDX-License-Identifier: Apache-2.0
 */

#include <zephyr/kernel.h>
#include <zephyr/drivers/uart.h>

#include "api.h"

int main(void)
{
	api_init();
	
	static const struct device *const uart = DEVICE_DT_GET(DT_CHOSEN(zephyr_console));
	uint32_t last_rts = 0;
	uint32_t last_dtr = 0;
	uint32_t last_dcd = 0;
	uint32_t last_dsr = 0;
	
	while (1)
	{
		api_handle_events();
		k_sleep(K_MSEC(1));
		
		uint32_t rts = 0;
		uint32_t dtr = 0;
		uint32_t dcd = 0;
		uint32_t dsr = 0;
		uart_line_ctrl_get(uart, UART_LINE_CTRL_RTS, &rts);
		uart_line_ctrl_get(uart, UART_LINE_CTRL_DTR, &dtr);
		uart_line_ctrl_get(uart, UART_LINE_CTRL_DCD, &dcd);
		uart_line_ctrl_get(uart, UART_LINE_CTRL_DSR, &dsr);
		if (
			last_rts != rts ||
			last_dtr != dtr ||
			last_dcd != dcd ||
			last_dsr != dsr
			)
		{
			last_rts = rts;
			last_dtr = dtr;
			last_dcd = dcd;
			last_dsr = dsr;
			api_send_notification(API_FUNCTION_UART, NULL, false);
		}
	}
	return 0;
}
```

## src/api.c
```c
#include "api.h"

#include <string.h>
#include <zephyr/kernel.h>
#include <zephyr/logging/log.h>
#include <zephyr/drivers/uart.h>

#include "rion_application_interface.h"
#include "serial.h"

//////////////////////////////////////////////////////////////////////////////////////////////////////////////////////////
// DEFINITIONS AND STATIC VARIABLES
#define SOFTWARE_VERSION {0,0,0}
#define LOG_MODULE_NAME api
LOG_MODULE_REGISTER(LOG_MODULE_NAME, LOG_LEVEL_INF);
static uint8_t input_buffer[256];
static int64_t last_time_received = 0;
typedef struct send_notification_msgq_item
{
	rion_encoding_key_short_t key;
	rion_encoding_object_t const* args;
	bool verbose;
}send_notification_msgq_item_t;
K_MSGQ_DEFINE(send_notifications_msgq, sizeof(send_notification_msgq_item_t), 8, 4);
//////////////////////////////////////////////////////////////////////////////////////////////////////////////////////////


//////////////////////////////////////////////////////////////////////////////////////////////////////////////////////////
// STATIC FUNCTION DECLARATIONS
static void send(uint8_t const* p_data, int len);
static void function_hello(rion_encoding_object_t const* args, bool verbose);
static void function_echo(rion_encoding_object_t const* args, bool verbose);
static void function_counter(rion_encoding_object_t const* args, bool verbose);
static void function_uart(rion_encoding_object_t const* args, bool verbose);
static void send_notifications_work_queue_handler(struct k_work * work);
//////////////////////////////////////////////////////////////////////////////////////////////////////////////////////////


//////////////////////////////////////////////////////////////////////////////////////////////////////////////////////////
// FUNCTION DEPENDENT STATIC VARIABLES
static rion_application_interface_function_t functions[API_FUNCTION_COUNT] = {
	[API_FUNCTION_HELLO] = { .name = "hello", .function = function_hello },
	[API_FUNCTION_ECHO] = { .name = "echo", .function = function_echo },
	[API_FUNCTION_COUNTER] = { .name = "counter", .description = "counts up when called", .function = function_counter },
	[API_FUNCTION_UART] = { .name = "uart", .function = function_uart },
};

K_WORK_DEFINE(send_notification_work, send_notifications_work_queue_handler);
//////////////////////////////////////////////////////////////////////////////////////////////////////////////////////////


//////////////////////////////////////////////////////////////////////////////////////////////////////////////////////////
// EVENT HANDLERS

//////////////////////////////////////////////////////////////////////////////////////////////////////////////////////////

//////////////////////////////////////////////////////////////////////////////////////////////////////////////////////////
// STATIC FUNCTION DEFINITIONS
static void send(uint8_t const* p_data, int len)
{
	static int const min_pause_between_transmissions = 5;
	static uint64_t last_time_sent = 0;
	uint64_t time_since_last_sent = k_uptime_get() - last_time_sent;
	if (time_since_last_sent < min_pause_between_transmissions)
	{
		k_sleep(K_MSEC(min_pause_between_transmissions - time_since_last_sent));
	}
	serial_send(K_FOREVER, p_data, len);
	serial_wait_for_tx_complete(K_MSEC(10));
	last_time_sent = k_uptime_get();
}

static void function_hello(rion_encoding_object_t const* args, bool verbose)
{
	char const hello_world_text[] = "hello world";
	rion_application_interface_response_append_string(NULL, hello_world_text, sizeof(hello_world_text) - 1);
}

static void function_echo(rion_encoding_object_t const* args, bool verbose)
{
	if (args->type == RION_ENCODING_FIELD_TYPE_UTF8_SHORT
	|| args->type == RION_ENCODING_FIELD_TYPE_UTF8)
	{
		rion_application_interface_response_append_string(NULL, (char const*)(args->p_content), args->content_size);
	}
}

static void function_counter(rion_encoding_object_t const* args, bool verbose)
{
	static int counter = 0;
	rion_application_interface_response_append_int(NULL, ++counter);
}

static void function_uart(rion_encoding_object_t const* args, bool verbose)
{
	static const struct device *const uart = DEVICE_DT_GET(DT_CHOSEN(zephyr_console));
	uint32_t rts = 0;
	uint32_t dtr = 0;
	uint32_t dcd = 0;
	uint32_t dsr = 0;
	uart_line_ctrl_get(uart, UART_LINE_CTRL_RTS, &rts);
	uart_line_ctrl_get(uart, UART_LINE_CTRL_DTR, &dtr);
	uart_line_ctrl_get(uart, UART_LINE_CTRL_DCD, &dcd);
	uart_line_ctrl_get(uart, UART_LINE_CTRL_DSR, &dsr);
	rion_application_interface_response_append_key(NULL, "rts", 3);
	rion_application_interface_response_append_int(NULL,  rts);
	rion_application_interface_response_append_key(NULL, "dtr", 3);
	rion_application_interface_response_append_int(NULL,  dtr);
	rion_application_interface_response_append_key(NULL, "dcd", 3);
	rion_application_interface_response_append_int(NULL,  dcd);
	rion_application_interface_response_append_key(NULL, "dsr", 3);
	rion_application_interface_response_append_int(NULL,  dsr);
}

static void send_notifications_work_queue_handler(struct k_work * work)
{
	for (int i = 0; i < send_notifications_msgq.max_msgs; i++)
	{
		send_notification_msgq_item_t item;
		if (k_msgq_get(&send_notifications_msgq, &item, K_NO_WAIT) != 0)
		{
			break;
		}
		rion_application_interface_send_notification(&api, item.key, item.args, item.verbose);
	}
}
//////////////////////////////////////////////////////////////////////////////////////////////////////////////////////////

rion_application_interface_t api = {
	.version = SOFTWARE_VERSION,
	.name = "template_test",
	.send_function = send,
	.function_list = functions,
	.function_count = sizeof(functions)/sizeof(rion_application_interface_function_t),
};

void api_init()
{
	serial_enable(SERIAL_TYPE_UART | SERIAL_TYPE_BLE);
}

void api_handle_events()
{
	static int bytes_in_input_buffer = 0;
	serial_line_t const* p_line = serial_get_line(K_NO_WAIT);
	
	//if no data was received before timeout discard the input buffer and wait for new data
	int const receive_timeout = 1000;
	if (p_line->len == 0) 
	{
		if ((bytes_in_input_buffer > 0) && ((k_uptime_get() - last_time_received) > receive_timeout))
		{
			LOG_INF("Did not receive data for %d msecs, discarding %d bytes", receive_timeout, bytes_in_input_buffer);
			bytes_in_input_buffer = 0;
		}
		return;
	}
	else
	{
		last_time_received = k_uptime_get();
	}
		
	//if the new data does not fit into the input buffer discard the input buffer
	if (bytes_in_input_buffer + p_line->len > sizeof(input_buffer))
	{
		bytes_in_input_buffer = 0;
	}
	
	//if it fits into the input buffer copy the data and handle the message
	if (p_line->len <= sizeof(input_buffer))
	{
		memcpy(input_buffer + bytes_in_input_buffer, p_line->p_data, p_line->len);
		bytes_in_input_buffer += p_line->len;
		
		if (rion_application_interface_handle_message(&api, input_buffer, bytes_in_input_buffer) == RION_APPLICATION_INTERFACE_CODE_SUCCESS)
		{
			bytes_in_input_buffer = 0;
		}
	}
}

void api_send_notification(api_function_t function, rion_encoding_object_t const * args, bool verbose)
{
	send_notification_msgq_item_t item = { 
		.key = RION_APPLICATION_INTERFACE_GET_KEY_SHORT(function),
		.args = args,
		.verbose = verbose,
	};
	int result = k_msgq_put(&send_notifications_msgq, &item, K_NO_WAIT);
	if (result != 0)
	{
		LOG_ERR("Could not put item on send notification message queue! (Error: %d)", result);
	}
	k_work_submit(&send_notification_work);
}
```

## src/api.h
```c
/*
 * application_interface.h
 *
 * Created: 12.02.2024 15:57:38
 *  Author: manuel.martin
 */ 


#ifndef API_H_
#define API_H_

#include "rion_application_interface.h"

typedef enum api_function {
	API_FUNCTION_HELLO,
	API_FUNCTION_ECHO,
	API_FUNCTION_COUNTER,
	API_FUNCTION_UART,
	API_FUNCTION_COUNT,
} api_function_t;

extern rion_application_interface_t api;

void api_init(void);
void api_handle_events(void);

void api_send_notification(api_function_t function, rion_encoding_object_t const * args, bool verbose);

#endif /* API_H_ */
```
